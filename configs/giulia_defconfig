## configs/giulia_defconfig
```kconfig
# First kernel-entry build. No unverified device-specific I/O drivers.
CONFIG_XNU_SOURCE_CORECRYPTO14=y
CONFIG_XNU_SOURCE_PTHREAD=y
CONFIG_XNU_ARM_DT_PLATFORM=y
CONFIG_XNU_ARMCPU=y
CONFIG_XNU_NATIVE_ARCH_TIMER=y
CONFIG_XNU_NATIVE_PAN=y
CONFIG_XNU_DT_PANIC_REGION=y
CONFIG_XNU_TRUST_CACHE_RUNTIME=y
CONFIG_XNU_NATIVE_CS_HASH_CACHE=y
CONFIG_XNU_CRYPTO_BOOTSTRAP="prelinked"
CONFIG_XNU_ARMVIRT_PLATFORM=n
CONFIG_XNU_NATIVE_UFS=n
CONFIG_XNU_NATIVE_AES=n
CONFIG_XNU_NATIVE_VIRTIO_BLOCK=n
CONFIG_XNU_NATIVE_RAM_BLOCK=n
CONFIG_XNU_NATIVE_LEGACY_DISPLAY=n
CONFIG_XNU_NATIVE_MOBILE_DISPLAY=n
CONFIG_XNU_NATIVE_ADRENO=n
CONFIG_XNU_SHENG_PMGR=n
CONFIG_XNU_BOOT_PROGRESS=n
CONFIG_XNU_VERIFIED_ROOT_PROBE=n
CONFIG_XNU_OWNER_ROOT_AUDIT=n
CONFIG_XNU_OWNER_ROOT_TRUST=n
CONFIG_XNU_OWNER_CACHE_MOUNT=n
CONFIG_XNU_OWNER_CACHE_STARTUP=n
CONFIG_XNU_OWNER_BOOT_MANIFEST=n
CONFIG_XNU_OWNER_DATA_MOUNT=n
CONFIG_XNU_OWNER_UNION_SYSTEMOS=n
```
